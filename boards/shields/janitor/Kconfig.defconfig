## boards/shields/janitor/Kconfig.defconfig
```kconfig
if SHIELD_JANITOR_LEFT

config ZMK_KEYBOARD_NAME
	default "Janitor"

config ZMK_SPLIT_ROLE_CENTRAL
	default y

endif

if SHIELD_JANITOR_LEFT || SHIELD_JANITOR_RIGHT

config ZMK_SPLIT
	default y

config ZMK_DISPLAY
	default y

endif
```

## boards/shields/janitor/Kconfig.shield
```kconfig
config SHIELD_JANITOR_LEFT
	def_bool $(shields_list_contains,janitor_left)
config SHIELD_JANITOR_RIGHT
	def_bool $(shields_list_contains,janitor_right)
```
